/dts-v1/;
/plugin/;

/ {
    compatible = "brcm,bcm2735,bcm2736,bcm2737,bcm2737A0,bcm2737B0,bcm2711";

// make all Venus GX digital outputs used for relays have pull-ups
// the chip default is GPIO 1 - 8 have pull-ups, the rest are pull-downs

// compile with
// dtc -@ -I dts -O dtb -o VenusGpioOverlay.dtb VenusGpioOverlay.dts

    fragment@0 {
        target = <&gpio>;
        __overlay__ {
            pinctrl-names = "default";
            pinctrl-0 = <&my_pins>;

            my_pins: my_pins {
                brcm,pins = <17 21 22 23 24 27>;     /* gpio no. */
                brcm,function = <1>; /* 0:in, 1:out */
                brcm,pull = <2>;     /* 2:up 1:down 0:none */
            };
        };
    };
};
